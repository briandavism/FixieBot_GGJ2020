/* 
 *  GGJ 2020
 *  by: Brian D. (dev & design & hw), Taru M. (dev & design), Elvira M. (art & design), Kevin A. (3D printing & design).
 * 
 * Inspired by the Tamaguino project by Alojz Jakob 
 * <http://jakobdesign.com>
 * 
 * 
 */

#include <SPI.h>
#include <Wire.h>
#include <Adafruit_GFX.h>
#include <Adafruit_SSD1306.h> 
#include <Fonts/FreeMonoBoldOblique12pt7b.h>
/*make sure to edit the ssd1306 library config to specify 
a 128x64 px screen
*/

#define OLED_RESET 4
Adafruit_SSD1306 display(OLED_RESET);

#define SCREEN_WIDTH 128        // OLED display width, in pixels
#define SCREEN_HEIGHT 64        // OLED display height, in pixels

// Pin IDs
const int encoderTurnPin = 2;   // Pin number for encoder (key)
//const int encoderPressPin = 8;  // Pin number for encoder (key) press
const int talkingPin = A1;       // Pin number for talking
const int soundPin = 6;         // Pin number for sound
int referenceVoltagePin = A0;   // Reference voltage pin (might not be in use)
int pot1Pin = A3;               // Potentio 1 pin 
int pot2Pin = A2;               // Potentio 2 pin 
int sliderPin = A1;             // Slider pin

// Stats
float stat_power = 0;           // Robot's power, starts from 0

// States
enum states {
  IDLE,               // If idle
  NEEDS_POWER,        // If robot needs power
  BEING_POWERED,      // If robot is being powered
  POWERING_DONE,      // If powering is done
  NEEDS_TALKING,      // If robot wants to talk
  BEING_DECRYPTED,    // If robot message is being decrypted
  DECRYPTING_DONE     // If decrypting is done
};

int state = IDLE;     // Initial state setup

// Flags
bool generateEventPressed = false;  // A bool to check if the event button was pressed (needs to be implemented)
bool firstIdleFrame = true;         // Setting the first idle frame to be true at start (idle initiation flag)

bool needsPowerSoundPlayed = false;  
bool needsTalkingSoundPlayed = false; 
bool doneDecryptingSoundPlayed = false;
bool donePoweringSoundPlayed = false;
bool isIncreasingPower = false;


// Minigame 1 initializing
int referenceVoltageValue = 0;
int sliderValue = 0;
int pot1Value = 0;
int pot2Value = 0;

int sliderTarget = 100; //target in pixels from 1-119 Will be randomized
int pot1Target = 1;
int pot2Target = 50;


// Delay related variables
unsigned long timeLatestIdleStarted;
int eventDelay;                     // Next event delay, randomized every time idle starts running

// Timer for powered picture
unsigned long lastPoweredPicture1;
unsigned long lastPoweredPicture2;
int poweredPictureDelay = 1000;

// Counter of encoder tics for sound generation
int encoderCount;

// Layout variables
int text_x = 30;                    // Talking text x coordinate
int text_y = 38;                    // Talking text y coordinate

// IMAGES | Todo: These would be better split to another file
const unsigned char eyes_closed [] PROGMEM = {
// 'eyes-closed', 128x64px
  0x00, 0x00, 0x00, 0x00, 0x00, 0x00, 0x00, 0x00, 0x00, 0x00, 0x00, 0x00, 0x00, 0x00, 0x00, 0x00, 
  0x00, 0x00, 0x00, 0x00, 0x00, 0x00, 0x00, 0x00, 0x00, 0x00, 0x00, 0x00, 0x00, 0x00, 0x00, 0x00, 
  0x00, 0x00, 0x00, 0x00, 0x00, 0x00, 0x00, 0x00, 0x00, 0x00, 0x00, 0x00, 0x00, 0x00, 0x00, 0x00, 
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  0x00, 0x00, 0x00, 0x00, 0x00, 0x00, 0x00, 0x00, 0x00, 0x00, 0x00, 0x00, 0x00, 0x00, 0x00, 0x00
};
const unsigned char eyes_open [] PROGMEM = {
// 'eyes-open', 128x64px
  0x00, 0x00, 0x00, 0x00, 0x00, 0x00, 0x00, 0x00, 0x00, 0x00, 0x00, 0x00, 0x00, 0x00, 0x00, 0x00, 
  0x00, 0x00, 0x00, 0x00, 0x00, 0x00, 0x00, 0x00, 0x00, 0x00, 0x00, 0x00, 0x00, 0x00, 0x00, 0x00, 
  0x00, 0x00, 0x00, 0x00, 0x00, 0x00, 0x00, 0x00, 0x00, 0x00, 0x00, 0x00, 0x00, 0x00, 0x00, 0x00, 
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  0x00, 0x00, 0x00, 0x00, 0x00, 0x00, 0x00, 0x00, 0x00, 0x00, 0x00, 0x00, 0x00, 0x00, 0x00, 0x00
};

const unsigned char needs_power_1 [] PROGMEM = {
  0x00, 0x00, 0x00, 0x00, 0x00, 0x00, 0x00, 0x00, 0x00, 0x00, 0x00, 0x00, 0x00, 0x00, 0x00, 0x00, 
  0x00, 0x00, 0x00, 0x00, 0x00, 0x00, 0x00, 0x00, 0x00, 0x00, 0x00, 0x00, 0x00, 0x00, 0x00, 0x00, 
  0x00, 0x00, 0x00, 0x00, 0x00, 0x00, 0x00, 0x00, 0x00, 0x00, 0x00, 0x00, 0x00, 0x00, 0x00, 0x00, 
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  0x00, 0x00, 0x00, 0x00, 0x00, 0x00, 0x00, 0x00, 0x00, 0x00, 0x00, 0x00, 0x00, 0x00, 0x00, 0x00
};

const unsigned char needs_power_2 [] PROGMEM = {
  0x00, 0x00, 0x00, 0x00, 0x00, 0x00, 0x00, 0x00, 0x00, 0x00, 0x00, 0x00, 0x00, 0x00, 0x00, 0x00, 
  0x00, 0x00, 0x00, 0x00, 0x00, 0x00, 0x00, 0x00, 0x00, 0x00, 0x00, 0x00, 0x00, 0x00, 0x00, 0x00, 
  0x00, 0x00, 0x00, 0x00, 0x00, 0x00, 0x00, 0x00, 0x00, 0x00, 0x00, 0x00, 0x00, 0x00, 0x00, 0x00, 
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  0x00, 0x00, 0x00, 0x00, 0x00, 0x00, 0x00, 0x00, 0x00, 0x00, 0x00, 0x00, 0x00, 0x00, 0x00, 0x00
};

const unsigned char powering_1 [] PROGMEM = {
 0x00, 0x00, 0x00, 0x00, 0x00, 0x00, 0x00, 0x00, 0x00, 0x00, 0x00, 0x00, 0x00, 0x00, 0x00, 0x00, 
  0x00, 0x00, 0x00, 0x00, 0x00, 0x00, 0x00, 0x00, 0x00, 0x00, 0x00, 0x00, 0x00, 0x00, 0x00, 0x00, 
  0x00, 0x00, 0x00, 0x00, 0x00, 0x00, 0x00, 0x00, 0x00, 0x00, 0x00, 0x00, 0x00, 0x00, 0x00, 0x00, 
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  0x00, 0x00, 0x00, 0x00, 0x00, 0x00, 0x00, 0x00, 0x00, 0x00, 0x00, 0x00, 0x00, 0x00, 0x00, 0x00
};

const unsigned char powering_2 [] PROGMEM = {
 0x00, 0x00, 0x00, 0x00, 0x00, 0x00, 0x00, 0x00, 0x00, 0x00, 0x00, 0x00, 0x00, 0x00, 0x00, 0x00, 
  0x00, 0x00, 0x00, 0x00, 0x00, 0x00, 0x00, 0x00, 0x00, 0x00, 0x00, 0x00, 0x00, 0x00, 0x00, 0x00, 
  0x00, 0x00, 0x00, 0x00, 0x00, 0x00, 0x00, 0x00, 0x00, 0x00, 0x00, 0x00, 0x00, 0x00, 0x00, 0x00, 
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  0x00, 0x00, 0x00, 0x00, 0x00, 0x00, 0x00, 0x00, 0x00, 0x00, 0x00, 0x00, 0x00, 0x00, 0x00, 0x00
};

const unsigned char eyes_satisfied [] PROGMEM = {
 0x00, 0x00, 0x00, 0x00, 0x00, 0x00, 0x00, 0x00, 0x00, 0x00, 0x00, 0x00, 0x00, 0x00, 0x00, 0x00, 
  0x00, 0x00, 0x00, 0x00, 0x00, 0x00, 0x00, 0x00, 0x00, 0x00, 0x00, 0x00, 0x00, 0x00, 0x00, 0x00, 
  0x00, 0x00, 0x00, 0x00, 0x00, 0x00, 0x00, 0x00, 0x00, 0x00, 0x00, 0x00, 0x00, 0x00, 0x00, 0x00, 
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  0x00, 0x00, 0x00, 0x00, 0x00, 0x00, 0x00, 0x00, 0x00, 0x00, 0x00, 0x00, 0x00, 0x00, 0x00, 0x00
};


const unsigned char needs_talking_1 [] PROGMEM = {
  0x00, 0x00, 0x00, 0x00, 0x00, 0x00, 0x00, 0x00, 0x00, 0x00, 0x00, 0x00, 0x00, 0x00, 0x00, 0x00, 
  0x00, 0x00, 0x00, 0x00, 0x00, 0x00, 0x00, 0x00, 0x00, 0x00, 0x00, 0x00, 0x00, 0x00, 0x00, 0x00, 
  0x00, 0x00, 0x00, 0x00, 0x00, 0x00, 0x00, 0x00, 0x00, 0x00, 0x00, 0x00, 0x00, 0x00, 0x00, 0x00, 
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  0x00, 0x00, 0x00, 0x00, 0x00, 0x00, 0x00, 0x00, 0x00, 0x00, 0x00, 0x00, 0x00, 0x00, 0x00, 0x00
};

const unsigned char needs_talking_2 [] PROGMEM = {
  0x00, 0x00, 0x00, 0x00, 0x00, 0x00, 0x00, 0x00, 0x00, 0x00, 0x00, 0x00, 0x00, 0x00, 0x00, 0x00, 
  0x00, 0x00, 0x00, 0x00, 0x00, 0x00, 0x00, 0x00, 0x00, 0x00, 0x00, 0x00, 0x00, 0x00, 0x00, 0x00, 
  0x00, 0x00, 0x00, 0x00, 0x00, 0x00, 0x00, 0x00, 0x00, 0x00, 0x00, 0x00, 0x00, 0x00, 0x00, 0x00, 
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  0x00, 0x00, 0x00, 0x00, 0x00, 0x00, 0x00, 0x00, 0x00, 0x00, 0x00, 0x00, 0x00, 0x00, 0x00, 0x00
};

const unsigned char decrypting_done [] PROGMEM = {
  0x00, 0x00, 0x00, 0x00, 0x00, 0x00, 0x00, 0x00, 0x00, 0x00, 0x00, 0x00, 0x00, 0x00, 0x00, 0x00, 
  0x00, 0x00, 0x00, 0x00, 0x00, 0x00, 0x00, 0x00, 0x00, 0x00, 0x00, 0x00, 0x00, 0x00, 0x00, 0x00, 
  0x00, 0x00, 0x00, 0x00, 0x00, 0x00, 0x00, 0x00, 0x00, 0x00, 0x00, 0x00, 0x00, 0x00, 0x00, 0x00, 
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  0x00, 0x00, 0x00, 0x00, 0x00, 0x00, 0x00, 0x00, 0x00, 0x00, 0x00, 0x00, 0x00, 0x00, 0x00, 0x00
};


const unsigned char tongue [] PROGMEM = { 
  0x00, 0x00, 0x00, 0x00, 0x00, 0x00, 0x00, 0x00, 0x00, 0x00, 0x00, 0x00, 0x00, 0x00, 0x00, 0x00, 
  0x00, 0x00, 0x00, 0x00, 0x00, 0x00, 0x00, 0x00, 0x00, 0x00, 0x00, 0x00, 0x00, 0x00, 0x00, 0x00, 
  0x00, 0x00, 0x00, 0x00, 0x00, 0x00, 0x00, 0x00, 0x00, 0x00, 0x00, 0x00, 0x00, 0x00, 0x00, 0x00, 
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  0x00, 0x00, 0x00, 0x00, 0x00, 0x00, 0x00, 0x00, 0x00, 0x00, 0x00, 0x00, 0x00, 0x00, 0x00, 0x00
};



void setup() {
  Serial.begin(9600);
  pinMode(13,OUTPUT);
  pinMode(soundPin, OUTPUT);
  randomSeed(analogRead(6));                  // Randomizing the seed between different startup times (mostly for the minigame
  
  display.begin(SSD1306_SWITCHCAPVCC, 0x3C);

  // Encoder (key turner) setup
  pinMode(encoderTurnPin, INPUT_PULLUP);
  attachInterrupt(digitalPinToInterrupt(encoderTurnPin), increasePower, RISING); // commented out while testing
  //attachInterrupt(digitalPinToInterrupt(talkingPin), decryptMessage, RISING);

  //playStartupSound();
}


void loop() {

  // **** CHECKING THE ACTIVE STATE ****** //
  if (state == IDLE) { 
    Serial.println("We're in idle");
    
    // If idle & it's the first frame of the "round", reset some variables. 
    if (firstIdleFrame) {
      Serial.println("FirstIdleFrame");
      
      // Storing the idle start time for event triggering
      timeLatestIdleStarted = millis();
      
      // Generate a random delay between min & max for the next event to occur in millis
      eventDelay = generateEventTiming(7000, 10000); // Important! Min always needs to be more than the blink loop (e.g. 5000). Todo: find out why.

      // Resetting variables
      firstIdleFrame = false;
      needsPowerSoundPlayed = false;
      donePoweringSoundPlayed = false;
      needsTalkingSoundPlayed = false;
      doneDecryptingSoundPlayed = false;

      // Randomizing minigame variables
      sliderTarget = random(1,119);
      pot1Target = random(1,119);
      pot2Target = random(1,119);
    }

    /*
    // Testing event delay
    Serial.println(eventDelay);
    Serial.println(millis()-timeLatestIdleStarted);
    Serial.println((millis()-timeLatestIdleStarted) >= eventDelay); // 20 000 - 10 000 = 10 000 
    */
    
    // Play idle animation
    playIdle();
    
  } else if (state == NEEDS_POWER) {                            // If the robot needs power
    firstIdleFrame = true;                                      // Todo: fix so that the first idle frame=true is does not need to be repeated 
    playNeedsPower();
  } else if (state == BEING_POWERED) {                          // If the robot is being powered
    firstIdleFrame = true;
    playBeingPowered();
  } else if (state == POWERING_DONE) {                          // If the powering is done
    firstIdleFrame = true;
    playPoweringDone();
    stat_power = 0; // Just resetting the power back to zero for now
  } else if (state == NEEDS_TALKING) {                          // If the robot wants to talk
    firstIdleFrame = true;
    playNeedsTalking();
  } else if (state == BEING_DECRYPTED) {                          // If the robot wants to talk
    runMatchingGame();
    firstIdleFrame = true;
    // playBeingDecrypted(); // game takes over instead
  } else if (state == DECRYPTING_DONE) {                        // If the decryption is done
    firstIdleFrame = true;
    playDecryptingDone();
  }
  
  // ***** CONDITIONS & TRIGGERS FOR STATE CHANGES **** //
  
  // If power is full, switch to powering_done. Only place where the power is increased is from the beingpowered. Todo: transfer to the powering function instead?
  if (stat_power >= 100) {
    state = POWERING_DONE;
  }


  // If the generated random event delay since idle is past, trigger an event
  if (state == IDLE && (millis()-timeLatestIdleStarted) >= eventDelay) {
    Serial.println("Event triggered");
    int eventNumber =  random(0, 2); 
    
    //int eventNumber = 1;
    if (eventNumber == 0) { // Structure ready for multiple events
      state = NEEDS_POWER;
    }
    else if (eventNumber == 1) {
      state = NEEDS_TALKING;
    }
  }

  /*
  // TODO (if time): Add the key button to trigger a random change
  // if generate event button pressed (todo), generate random value between 0, 3(?), and activate the state
  if (generateEventPressed) {
    int eventNumber =  random(0, 1);
    if (eventNumber == 0) {
      state = NEEDS_POWER;
    }
    else if (eventNumber == 1) {
      state = NEEDS_TALKING;
    }
  }*/
}

int generateEventTiming(int min, int max) {
  int timing = random(min, max);
  return timing;
}

// SOUNDS //
void playStartupSound() {
  tone(soundPin,500,200);
  delay(200);
  tone(soundPin,1000,200);
  delay(400);
  tone(soundPin,700,200);
  delay(200);
  tone(soundPin,1100,200);
}

void playNeedsPowerSound() {
  if( needsPowerSoundPlayed != true) {
    tone(soundPin,700,50);
    delay(500);
    tone(soundPin,800,50);
    delay(500);
    tone(soundPin,600,50);
    needsPowerSoundPlayed = true;
  }
}
void playPoweredActionSound(){
  tone(soundPin,5000,20);
  delay(20);
}

void playDonePoweringSound() {
   if(donePoweringSoundPlayed != true) {
      tone(soundPin,10000,50);
      delay(50);
      tone(soundPin,8000,50);
      delay(50);
      tone(soundPin,10000,50);
      delay(50);
      tone(soundPin,8000,50);
      delay(50);
      tone(soundPin,8000,50);
      delay(50);
      tone(soundPin,10000,50);
      delay(50);
      tone(soundPin,10000,50);
      delay(50);
      tone(soundPin,8000,50);
      delay(50);
      tone(soundPin,8000,50);
      delay(50);
      tone(soundPin,10000,50);
      donePoweringSoundPlayed = true;
   }
}

void playNeedsTalkingSound() {
  if( needsTalkingSoundPlayed != true) {
    tone(soundPin,7000,50);
    delay(10);
    tone(soundPin,8000,50);
    delay(50);
    tone(soundPin,5000,100);
    delay(50);
    tone(soundPin,10000,50);
    delay(50);
    needsTalkingSoundPlayed = true;
    noTone(soundPin);
  }
}

void playDecryptActionSound() {
   tone(soundPin,5000,100);
}

void playDoneDecryptingSound() {
   if(doneDecryptingSoundPlayed != true) {
      tone(soundPin,10000,50);
      delay(50);
      tone(soundPin,8000,50);
      delay(50);
      tone(soundPin,10000,50);
      delay(50);
      tone(soundPin,8000,50);
      delay(50);
      tone(soundPin,8000,50);
      delay(50);
      tone(soundPin,10000,50);
      delay(50);
      tone(soundPin,10000,50);
      delay(50);
      tone(soundPin,8000,50);
      delay(50);
      tone(soundPin,8000,50);
      delay(50);
      tone(soundPin,10000,50);
      doneDecryptingSoundPlayed = true;
   }
}


// ANIMATIONS & STATE LOGIC //

void playIdle() {
  
  // Eyes open
  display.clearDisplay();
  display.drawBitmap(0, 0, eyes_open, 128, 64, WHITE);
  
  display.display();
  delay(2000); // eyes open for value

  // Switch between eye blink and tongue
  int variation = random(0,3);                  // Todo: this sometimes gets an unusable 2, fix
  if (variation == 0) {
    // Eyes blinking
    blinkEyes(500);                             // parameter: how long the eyes stay closed
    delay(500);
    blinkEyes(500);
  } else if (variation == 1) {
    showTongue(1500);
  }

}


// Closes eyes for the time of the duration and opens them
void blinkEyes(int duration) {
  display.clearDisplay();
  display.drawBitmap(0, 0, eyes_closed, 128, 64, WHITE);
  display.display();
  delay(duration);
  display.clearDisplay();
  display.drawBitmap(0, 0, eyes_open, 128, 64, WHITE);
  display.display();
}
void showTongue(int duration) {
  display.clearDisplay();
  display.drawBitmap(0, 0, tongue, 128, 64, WHITE);
  display.display();
  delay(duration);
  display.clearDisplay();
  display.drawBitmap(0, 0, eyes_open, 128, 64, WHITE);
  display.display();
}


void playNeedsPower() {
  
  // 1st picture
  display.clearDisplay();
  display.drawBitmap(0, 0, needs_power_1, 128, 64, WHITE);
  display.display();
  playNeedsPowerSound();
  delay(200);
  
  // 2nd picture
  display.clearDisplay();
  display.drawBitmap(0, 0, needs_power_2, 128, 64, WHITE);
  display.display();
  delay(200);
  
}

void playBeingPowered() {
  
  Serial.println("Inside the being powered loop");
  
  display.clearDisplay();

  // Animate between two pictures with a global delay
  int activePicture = 1;
  
  if ((millis()-lastPoweredPicture1) >= poweredPictureDelay) { 
    activePicture=1;
    lastPoweredPicture1 = millis();
  } else if ((millis()-lastPoweredPicture2) >= poweredPictureDelay){
    activePicture=2;
    lastPoweredPicture2 = millis();
  }

  if (activePicture == 1) {
    display.drawBitmap(0, 0, powering_2, 128, 64, WHITE);
  } else if (activePicture == 2) {
    display.drawBitmap(0, 0, powering_1, 128, 64, WHITE);
  }
  
  // Draw power bar
  display.drawRect(1,54,126,10,WHITE);
  display.fillRect(3,56,122 * stat_power / 100,8,WHITE);
 
  decreasePower();
  
  display.display();
}

void playPoweringDone() {
  display.clearDisplay();
  display.drawBitmap(0, 0, eyes_satisfied, 128, 64, WHITE);
  display.display();
  playDonePoweringSound();
  delay(1500);
  state = IDLE;
  timeLatestIdleStarted = millis(); // Hack: for some reason I need to define this here as well.
}

void playNeedsTalking() {
  
  playNeedsTalkingSound();
  
  for (int i = 0; i < 4; i++) {
    
    display.clearDisplay();
    display.drawBitmap(0, 0, needs_talking_1, 128, 64, WHITE);

    // Text
    display.setTextColor(SSD1306_BLACK);
    display.setCursor(text_x+1,text_y);
    display.setTextSize(1);
    display.cp437(true);
    display.print(F("z¤!¤%Zzz%"));
    
    display.display();
  
    delay(500);
    
    display.clearDisplay();
    display.drawBitmap(0, 0, needs_talking_2, 128, 64, WHITE);

    // Text (some re-definitions might be redundant)
    display.setTextColor(SSD1306_BLACK);
    display.setCursor(text_x+1,text_y);
    display.setTextSize(1);
    display.cp437(true);
    display.print(F("z¤!¤%Zzz%"));
    
    display.display();

    delay(500);
  }
  
  Serial.println("Switching to decrypted");
  state = BEING_DECRYPTED;
  
}


// Matching Game
void runMatchingGame() {
  //Serial.println("game lauched!");
  noTone(soundPin);

  
  display.clearDisplay(); // clear
  
  //Bars mini game
  display.drawRect(0,0,128,64,WHITE); //Screen Frame
  
  //Get values from pots
  pot1Value = analogRead(pot1Pin);
  delay(10);// this delay is to help the ADC differentiate the 3 signals
  pot1Value = analogRead(pot1Pin);
  
  pot2Value = analogRead(pot2Pin);
  delay(10);
  pot2Value = analogRead(pot2Pin);
  
  sliderValue = analogRead(sliderPin);
  delay(10);
  sliderValue = analogRead(sliderPin);

  referenceVoltageValue = analogRead(referenceVoltagePin);
  delay(10);
  referenceVoltageValue = analogRead(referenceVoltagePin);
  
  //the balance lines
  display.drawLine(4,20,123,20,WHITE); 
  display.drawLine(4,37,123,37,WHITE);
  display.drawLine(4,54,123,54,WHITE);

  int target1min = (int)((121-2) / 100 * sliderTarget+2);
  int target2min = (int)((121-2) / 100 * pot1Target+2);
  int target3min = (int)((121-2) / 100 * pot2Target+2);
  
  int targetWidth = 5;

  int target1max = (int)(target1min + targetWidth);
  int target2max = (int)(target2min + targetWidth);
  int target3max = (int)(target3min + targetWidth);
  
  //the target cursors
  display.drawRect(target1min,15,targetWidth,11,WHITE); // Todo: check int rounding
  display.drawRect(target2min,32,targetWidth,11,WHITE);
  display.drawRect(target3min,49,targetWidth,11,WHITE);
  
  int sliderPixel = (123-4)*(sliderValue/(float)referenceVoltageValue);
  int pot1Pixel = (123-4)*(pot1Value/(float)referenceVoltageValue);
  int pot2Pixel = (123-4)*(pot2Value/(float)referenceVoltageValue);
  
  
  //Current Values
  display.drawLine(sliderPixel+4,17,sliderPixel+4,23,WHITE);
  display.drawLine(pot1Pixel+4,34,pot1Pixel+4,40,WHITE);
  display.drawLine(pot2Pixel+4,51,pot2Pixel+4,57,WHITE);
  
  display.display(); // draw

  /*
  Serial.print(target1min);
  Serial.print(" ");
  Serial.print(sliderPixel-targetWidth);
    Serial.print(" ");
  Serial.print(target1max);
  Serial.println();

  Serial.print(target2min);
    Serial.print(" ");
  Serial.print(pot1Pixel-targetWidth);
    Serial.print(" ");
  Serial.print(target2max);
  Serial.println();

  Serial.print(target3min);
    Serial.print(" ");
  Serial.print(pot2Pixel-targetWidth);
    Serial.print(" ");
  Serial.print(target3max);
  Serial.println();

  // Checking for winning condition, offset hacked
  if (target1min <= (sliderPixel+targetWidth) && (sliderPixel+targetWidth) <= target1max){
    Serial.println("1st one set!");
  }
  if (target2min <= (pot1Pixel+targetWidth) && (pot1Pixel+targetWidth) <= target2max) {
    Serial.println("2nd one set!");
  }
  if (target3min <= (pot2Pixel+targetWidth) && (pot2Pixel+targetWidth) <= target3max){
    Serial.println("3rd one set!");
  } */

  // State to decrypting done when winning conditions are met
  if ((target1min <= (sliderPixel+targetWidth) && (sliderPixel+targetWidth) <= target1max) &&
      (target2min <= (pot1Pixel+targetWidth) && (pot1Pixel+targetWidth) <= target2max) &&
      (target3min <= (pot2Pixel+targetWidth) && (pot2Pixel+targetWidth) <= target3max)) {
    state = DECRYPTING_DONE;
  }
}



/*
void playBeingDecrypted() {
  display.setTextColor(SSD1306_BLACK);
  display.setCursor(text_x,text_y);
  display.setTextSize(1);
  display.cp437(true);
  
  display.clearDisplay();
  display.drawBitmap(0, 0, needs_talking_1, 128, 64, WHITE);
  display.print(F("z¤!¤%Zzz%"));
  display.display();
  
  delay(500);
  
  display.clearDisplay();
  display.drawBitmap(0, 0, needs_talking_2, 128, 64, WHITE);

  display.setTextColor(SSD1306_BLACK);
  display.setCursor(text_x,text_y);
  display.setTextSize(1);
  display.cp437(true);
  display.print(F("z¤!¤%Zzz%"));
  display.display();
  
  delay(500);
}*/

void playDecryptingDone() {
  display.clearDisplay();
  display.drawBitmap(0, 0, decrypting_done, 128, 64, WHITE);

  
  // Print text to the screen
  display.setTextColor(SSD1306_BLACK);
  display.setTextSize(1);
  display.cp437(true);
  
  int variation = random(0,3);
  if (variation == 0) {
    display.setCursor(text_x-5,text_y); 
    display.print(F("You're great!"));
  } else if (variation == 1) {
    display.setCursor(text_x-8,text_y); 
    display.print(F("I'm fixie bot!"));
  } else if (variation == 2) {
    display.setCursor(text_x+5,text_y); 
    display.print(F("GGJ2020 <3"));
  }
  
  display.display();

  // Play sound
  playDoneDecryptingSound();

  // Show the message for x amount of time
  delay(6000);
  
  // Returning to idle
  state = IDLE;
  timeLatestIdleStarted = millis(); // Hack: for some reason I need to define this here instead of the main loop.
}



/* POWER FUNCTIONS */
void increasePower() {
    if (state == NEEDS_POWER || state == BEING_POWERED) { // Only run if the state is needs power or being powered
      state = BEING_POWERED;                              // Switch state to being powered

      if (isIncreasingPower != true) {            // Check that the sound has been played till end until triggering the next event from the control
        if (stat_power < 100) {
          
          //Serial.println("Increased power");
          isIncreasingPower = true;               // Keeps global track of the function status, so that interrupts don't collide 
          stat_power = stat_power + 0.5;

          // Launches sound only every 10 updates
          encoderCount++;
          if (encoderCount > 10) {
            //playPoweredActionSound();           // Todo: This bugs for some reason... Try later
            encoderCount = 0;
          }
          // Returning status to false
          isIncreasingPower = false;
        }
    }
  }
}

void decreasePower() {
   if (stat_power > 0) {
    stat_power = stat_power - 0.5;

    // If the power ends up below zero, reset to zero
    if (stat_power < 0)
      stat_power = 0;
  }
}






